## src/mainboard/dell/latitude_e7240/Kconfig
```kconfig
if BOARD_DELL_LATITUDE_E7240

config BOARD_SPECIFIC_OPTIONS
	def_bool y
	select BOARD_ROMSIZE_KB_8192
	select EC_DELL_MEC5055
	select HAVE_ACPI_RESUME
	select HAVE_ACPI_TABLES
	select INTEL_INT15
	select INTEL_LYNXPOINT_LP
	select MAINBOARD_HAS_LIBGFXINIT
	select NORTHBRIDGE_INTEL_HASWELL
	select SERIRQ_CONTINUOUS_MODE
	select SOUTHBRIDGE_INTEL_LYNXPOINT
	select SYSTEM_TYPE_LAPTOP

config MAINBOARD_DIR
	string
	default "dell/latitude_e7240"

config MAINBOARD_PART_NUMBER
	string
	default "Latitude E7240"

config VGA_BIOS_FILE
	string
	default "pci8086,0a16.rom"

config VGA_BIOS_ID
	string
	default "8086,0a16"

config USBDEBUG_HCD_INDEX
	int
	default 1

endif
```

## src/mainboard/dell/optiplex_7010/Kconfig
```kconfig
if BOARD_DELL_OPTIPLEX_7010

config BOARD_SPECIFIC_OPTIONS
	def_bool y
	select BOARD_ROMSIZE_KB_12288
	select HAVE_ACPI_RESUME
	select HAVE_ACPI_TABLES
	select INTEL_INT15
	select NORTHBRIDGE_INTEL_SANDYBRIDGE
	select SERIRQ_CONTINUOUS_MODE
	select SOUTHBRIDGE_INTEL_C216
	select USE_NATIVE_RAMINIT
	select SUPERIO_SMSC_SCH5545

config MAINBOARD_DIR
	string
	default "dell/optiplex_7010"

config MAINBOARD_PART_NUMBER
	string
	default "OptiPlex 7010"

config DRAM_RESET_GATE_GPIO # FIXME: check this
	int
	default 60

config USBDEBUG_HCD_INDEX # FIXME: check this
	int
	default 2

config INCLUDE_SMSC_SCH5545_EC_FW
        bool "Include SMSC SCH5545 EC firmware binary"
        default n
        help
          This option allows to add the SMSC SCH5545 Environmental Controller
          firmware binary. The firmware must be loaded after each power failure
          in order to properly initialize the fan control, because EC loses its
          configuration when power is cut off. Otherwise the fans will keep
          running at full speed after power failure.

config SMSC_SCH5545_EC_FW_FILE
        string "File path to the SMSC SCH5545 EC firmware binary"
        depends on INCLUDE_SMSC_SCH5545_EC_FW

endif
```

## src/mainboard/lenovo/lenovo_y40_70/Kconfig
```kconfig
if BOARD_LENOVO_LENOVO_Y40_70

config BOARD_SPECIFIC_OPTIONS
	def_bool y
	select BOARD_ROMSIZE_KB_8192
	select CPU_INTEL_HASWELL
	select EC_LENOVO_H8
	select EC_LENOVO_PMH7
	select HAVE_ACPI_RESUME
	select HAVE_ACPI_TABLES
	select INTEL_INT15
	select INTEL_LYNXPOINT_LP
	select MAINBOARD_HAS_LIBGFXINIT # FIXME: check this
	select NORTHBRIDGE_INTEL_HASWELL
	select SERIRQ_CONTINUOUS_MODE
	select SOUTHBRIDGE_INTEL_LYNXPOINT
	select SYSTEM_TYPE_LAPTOP

config MAINBOARD_DIR
	string
	default lenovo/lenovo_y40_70

config MAINBOARD_PART_NUMBER
	string
	default "Lenovo Y40-70"

config VGA_BIOS_FILE
	string
	default "pci8086,0a16.rom"

config VGA_BIOS_ID
	string
	default "8086,0a16"

config USBDEBUG_HCD_INDEX # FIXME: check this
	int
	default 2
endif
```
